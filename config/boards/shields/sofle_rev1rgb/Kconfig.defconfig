## config/boards/shields/sofle_rev1rgb/Kconfig.defconfig
```kconfig
if SHIELD_SOFLE_REV1RGB_LEFT

config ZMK_KEYBOARD_NAME
	default "Sofle"

config ZMK_SPLIT_ROLE_CENTRAL
	default y
	
endif

if  SHIELD_SOFLE_REV1RGB_LEFT|| SHIELD_SOFLE_REV1RGB_RIGHT

config ZMK_SPLIT
	default y

config ZMK_RGB_UNDERGLOW
	select WS2812_STRIP
	select SPI

if ZMK_DISPLAY

config I2C
	default y

config SSD1306
	default y

config SSD1306_REVERSE_MODE
	default y

endif # ZMK_DISPLAY

if LVGL

config LVGL_VDB_SIZE
	default 64

config LVGL_DPI
	default 148

config LVGL_BITS_PER_PIXEL
	default 1

choice LVGL_COLOR_DEPTH
	default LVGL_COLOR_DEPTH_1
endchoice

endif # LVGL

endif
```

## config/boards/shields/sofle_rev1rgb/Kconfig.shield
```kconfig
config SHIELD_SOFLE_REV1RGB_LEFT
    def_bool $(shields_list_contains,sofle_rev1rgb_left)

config SHIELD_SOFLE_REV1RGB_RIGHT
    def_bool $(shields_list_contains,sofle_rev1rgb_right)
```
